## main/Kconfig.projbuild
```kconfig
menu "My Project Config"
    menu "WIFI Config"

        config WIFI_SSID
            string "WiFi SSID"
            default "smart_led_box"
            help
                AP Mode SSID (network name).

        config WIFI_PASSWORD
            string "WiFi Password"
            default "12345678"
            help
                WiFi password.
        config WIFI_CHANNEL
            int "WiFi Channel"
            range 1 13
            default 1
            help
                WiFi channel (network channel).

        config MAX_STA_CONN
            int "Maximal STA connections"
            default 2
            help
                Max number of the STA connects to AP.
    endmenu

endmenu
```
